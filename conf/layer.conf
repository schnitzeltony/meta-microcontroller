## conf/layer.conf
```bitbake
# We have a conf directory, append to BBPATH
BBPATH .= ":${LAYERDIR}"

# We have a recipes directory, add to BBFILES
BBFILES += "${LAYERDIR}/recipes*/*.bb ${LAYERDIR}/recipes*/*/*.bb"
# appends
BBFILES += "${LAYERDIR}/extends-*/*.bb ${LAYERDIR}/extends-*/*.bbappend"

BBFILES_DYNAMIC += " \
    meta-java:${LAYERDIR}/arduino-recipes/*.bb \
"

BBFILE_COLLECTIONS += "meta-microcontroller"
BBFILE_PATTERN_meta-microcontroller := "^${LAYERDIR}/"
BBFILE_PRIORITY_meta-microcontroller = "10"

LICENSE_PATH += "${LAYERDIR}/files/licenses"

LAYERDEPENDS_meta-microcontroller = "core openembedded-layer"
LAYERSERIES_COMPAT_meta-microcontroller = "dunfell"
```
